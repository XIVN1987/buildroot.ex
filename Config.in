## Config.in
```kconfig
menu "Packages"
source "$BR2_EXTERNAL_XV1987_PATH/package/libsox/Config.in"
source "$BR2_EXTERNAL_XV1987_PATH/package/rkbin/Config.in"
source "$BR2_EXTERNAL_XV1987_PATH/package/rtk_hciattach/Config.in"
endmenu
```

## configs/rockpi-s_defconfig
```kconfig
BR2_DL_DIR="$(TOPDIR)/../buildroot.dl"

BR2_TARGET_GENERIC_HOSTNAME="rockpi-s"
BR2_TARGET_GENERIC_ISSUE="Welcome to a RockPi S OS"

BR2_aarch64=y
BR2_cortex_a35=y

# uboot
BR2_TARGET_UBOOT=y
BR2_TARGET_UBOOT_BUILD_SYSTEM_KCONFIG=y
BR2_TARGET_UBOOT_CUSTOM_GIT=y
BR2_TARGET_UBOOT_CUSTOM_REPO_URL="https://github.com/radxa/u-boot.git"
BR2_TARGET_UBOOT_CUSTOM_REPO_VERSION="233a23e3ed0b3e5250253ee455c3c5df2080f99c"
BR2_TARGET_UBOOT_BOARD_DEFCONFIG="rock-pi-s-rk3308"

# linux
BR2_LINUX_KERNEL=y
BR2_LINUX_KERNEL_CUSTOM_GIT=y
BR2_LINUX_KERNEL_CUSTOM_REPO_URL="https://github.com/rockchip-linux/kernel.git"
BR2_LINUX_KERNEL_CUSTOM_REPO_VERSION="develop-5.10"
BR2_LINUX_KERNEL_USE_CUSTOM_CONFIG=y
BR2_LINUX_KERNEL_CUSTOM_CONFIG_FILE="$(BR2_EXTERNAL)/board/RK3308/rockpi-s"
BR2_LINUX_KERNEL_DTS_SUPPORT=y
BR2_LINUX_KERNEL_CUSTOM_DTS_PATH="$(BR2_EXTERNAL)/board/RK3308/rockpi-s.dts"

# filesystem
BR2_TARGET_ROOTFS_EXT2=y
BR2_TARGET_ROOTFS_EXT2_4=y
BR2_TARGET_ROOTFS_EXT2_SIZE="250M"

BR2_ROOTFS_OVERLAY="$(BR2_EXTERNAL)/overlay"

# post build sdcard image generaton
BR2_ROOTFS_POST_BUILD_SCRIPT="$(BR2_EXTERNAL)/board/RK3308/post-build.sh"
BR2_ROOTFS_POST_IMAGE_SCRIPT="$(BR2_EXTERNAL)/board/RK3308/post-image.sh"
BR2_ROOTFS_POST_SCRIPT_ARGS="RK3308"

# patches
BR2_GLOBAL_PATCH_DIR="$(BR2_EXTERNAL)/patches/RK3308"

# Rockchip Firmware and Tool Binarys
BR2_PACKAGE_RKBIN=y

# networking
BR2_PACKAGE_OPENSSH=y
BR2_PACKAGE_OPENSSH_SERVER=y
BR2_PACKAGE_OPENSSH_CLIENT=y

# bluetooth
BR2_PACKAGE_RTK_HCIATTACH=y
BR2_PACKAGE_BLUEZ5_UTILS=y
BR2_PACKAGE_BLUEZ5_UTILS_CLIENT=y
```
